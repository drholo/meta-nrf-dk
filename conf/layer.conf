## conf/layer.conf
```bitbake
LICENSE = "MIT"
# We have a conf and classes directory, add to BBPATH
BBPATH .= ":${LAYERDIR}"

# We have recipes-* directories, add to BBFILES
BBFILES += "${LAYERDIR}/recipes-*/*/*.bb \
            ${LAYERDIR}/recipes-*/*/*.bbappend"

BBFILE_COLLECTIONS += "meta-nrf-dk"
BBFILE_PATTERN_meta-nrf-dk = "^${LAYERDIR}/"
BBFILE_PRIORITY_meta-nrf-dk = "6"

LAYERDEPENDS_meta-nrf-dk = "core"
LAYERSERIES_COMPAT_meta-nrf-dk = "kirkstone"
```
